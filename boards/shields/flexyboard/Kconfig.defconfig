## boards/shields/flexyboard/Kconfig.defconfig
```kconfig
if SHIELD_FLEXYBOARD_LEFT

# Name must be less than 16 characters long!
config ZMK_KEYBOARD_NAME
    default "FLEXYBOARD"

config ZMK_SPLIT_ROLE_CENTRAL
    default y

endif

if SHIELD_FLEXYBOARD_LEFT || SHIELD_FLEXYBOARD_RIGHT

config ZMK_SPLIT
    default y

endif
```

## boards/shields/flexyboard/Kconfig.shield
```kconfig
config SHIELD_FLEXYBOARD_LEFT
    def_bool $(shields_list_contains,flexyboard_left)

config SHIELD_FLEXYBOARD_RIGHT
    def_bool $(shields_list_contains,flexyboard_right)
```
